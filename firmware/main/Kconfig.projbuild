## firmware/main/Kconfig.projbuild
```kconfig
menu "Posiflex clock"
    config POSIFLEX_WIFI_SSID
        string "Wi-Fi SSID"
        default ""

    config POSIFLEX_WIFI_PASSWORD
        string "Wi-Fi password"
        default ""
endmenu
```

## firmware/sdkconfig.defaults
```kconfig
CONFIG_LWIP_SNTP_MAX_SERVERS=2
CONFIG_ESPTOOLPY_FLASHSIZE_16MB=y
CONFIG_PARTITION_TABLE_SINGLE_APP_LARGE=y
```
